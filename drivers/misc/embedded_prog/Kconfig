## drivers/misc/embedded_prog/Kconfig
```kconfig
# SPDX-License-Identifier: GPL-2.0-only
config EMBEDDED_PROG
	tristate "example kernel driver with embedded userspace program"
	select USERMODE_DRIVER
	default y
```
